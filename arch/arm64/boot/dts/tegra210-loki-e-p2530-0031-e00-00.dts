/*
 * arch/arm64/boot/dts/tegra210-loki-e-p2530-0031-e00-00.dts
 *
 * Copyright (c) 2014, NVIDIA CORPORATION.  All rights reserved.
 *
 * This program is free software; you can redistribute it and/or modify
 * it under the terms of the GNU General Public License as published by
 * the Free Software Foundation; version 2 of the License.
 *
 * This program is distributed in the hope that it will be useful, but WITHOUT
 * ANY WARRANTY; without even the implied warranty of MERCHANTABILITY or
 * FITNESS FOR A PARTICULAR PURPOSE.  See the GNU General Public License for
 * more details.
 *
 * You should have received a copy of the GNU General Public License along
 * with this program; if not, write to the Free Software Foundation, Inc.,
 * 51 Franklin Street, Fifth Floor, Boston, MA  02110-1301, USA.
 *
 */

#include "tegra210-loki-e-p2530-0030-e00-00.dts"

/ {
	model = "loki_e_lte";
	nvidia,dtsfilename = __FILE__;

	modem {
		compatible = "nvidia,icera-i500";
		nvidia,boot-gpio = <&gpio TEGRA_GPIO(K, 6) GPIO_ACTIVE_LOW>;
		nvidia,mdm-power-report-gpio = <&gpio TEGRA_GPIO(L, 1) GPIO_ACTIVE_LOW>;
		nvidia,reset-gpio = <&gpio TEGRA_GPIO(L, 0) GPIO_ACTIVE_LOW>;
		nvidia,mdm-en-gpio = <&gpio TEGRA_GPIO(K, 7) GPIO_ACTIVE_HIGH>;
		nvidia,pre-boost-gpio = <&gpio TEGRA_GPIO(E, 5) GPIO_ACTIVE_HIGH>;
		nvidia,num-temp-sensors = <3>;
		/* using XHCI UTMI */
		nvidia,phy-type = <2>;
		status = "disabled";
	};

	xusb@70090000 {
		/* enable UTMI pad 1 */
		nvidia,portmap = <0x600>;
		usb_vbus1-supply = <&battery_reg>;
	};

	touch-leds-pwm-rework {
		status = "disabled";
	};
};
